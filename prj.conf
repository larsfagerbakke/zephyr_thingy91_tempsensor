## CMakeLists.txt
```
cmake_minimum_required(VERSION 3.20.0)
find_package(Zephyr REQUIRED HINTS $ENV{ZEPHYR_BASE})

project(zephyr_thingy91_tempsensor)

# Get a list of all .c files in the src directory
file(GLOB app_sources src/*.c)

# Add the source files to the target
target_sources(app PRIVATE ${app_sources})
```

## prj.conf
```kconfig
# Sensor config
CONFIG_SENSOR=y

# Debugger config
CONFIG_LOG=y
CONFIG_LOG_MODE_IMMEDIATE=y
CONFIG_RTT_CONSOLE=y
CONFIG_USE_SEGGER_RTT=y
CONFIG_FPU=y
```

## src/main.c
```c
#include <zephyr/kernel.h>

// Sensor support
#include <zephyr/drivers/sensor.h>

// Logging support
#include <zephyr/logging/log.h>

#include "led_handler.h"
#include "temp_sensor.h"

#define MODULE main
LOG_MODULE_REGISTER(MODULE, LOG_LEVEL_DBG);

int main(void)
{
    LOG_INF("Application starting...");

    int ret;

    ret = init_leds();
    if (ret < 0)
    {
        LOG_ERR("LED setup failed, error %d", ret);
        return 0;
    }

    ret = init_temp_sensor();
    if (ret < 0)
    {
        LOG_ERR("Temperature sensor setup failed, error %d", ret);
        return 0;
    }

    while (1)
    {
        float tempVal = get_temp();

        LOG_INF("Temperature: %f", tempVal);
        
        blink_led_color(LED_COLOR_BLUE, 4, 150);

        k_msleep(3000);
    }

    return 0;
}
```

## src/led_handler.c
```c
#include "led_handler.h"

#define LED0_NODE DT_ALIAS(led0)
#define LED1_NODE DT_ALIAS(led1)
#define LED2_NODE DT_ALIAS(led2)

static const struct gpio_dt_spec led0 = GPIO_DT_SPEC_GET(LED0_NODE, gpios);
static const struct gpio_dt_spec led1 = GPIO_DT_SPEC_GET(LED1_NODE, gpios);
static const struct gpio_dt_spec led2 = GPIO_DT_SPEC_GET(LED2_NODE, gpios);

static int setup_led(struct gpio_dt_spec led_spec)
{
    if (!gpio_is_ready_dt(&led_spec))
    {
        return -ENODEV;
    }

    int ret = gpio_pin_configure_dt(&led_spec, GPIO_OUTPUT_INACTIVE);
    if (ret < 0)
    {
        return ret;
    }

    return 0;
}

int init_leds()
{
    int ret;

    ret = setup_led(led0);
    if (ret < 0)
    {
        return ret;
    }

    ret = setup_led(led1);
    if (ret < 0)
    {
        return ret;
    }

    ret = setup_led(led2);
    if (ret < 0)
    {
        return ret;
    }

    return 0;
}

int toggle_led(enum led_num led)
{
    switch (led)
    {
    case LED_0:
        return gpio_pin_toggle_dt(&led0);
    case LED_1:
        return gpio_pin_toggle_dt(&led1);
    case LED_2:
        return gpio_pin_toggle_dt(&led2);
    default:
        return -EINVAL;
    }
}

int toggle_led_color(enum led_color color)
{
    switch (color)
    {
    case LED_COLOR_RED:
        // Toggle red LED
        return gpio_pin_toggle_dt(&led0);
    case LED_COLOR_GREEN:
        // Toggle green LED
        return gpio_pin_toggle_dt(&led1);
    case LED_COLOR_BLUE:
        // Toggle blue LED
        return gpio_pin_toggle_dt(&led2);
    case LED_COLOR_YELLOW:
        // Toggle yellow LED (combination of red and green)
        gpio_pin_toggle_dt(&led0);
        return gpio_pin_toggle_dt(&led1);
    case LED_COLOR_WHITE:
        gpio_pin_toggle_dt(&led0);
        gpio_pin_toggle_dt(&led1);
        return gpio_pin_toggle_dt(&led2);
    default:
        return -EINVAL;
    }
}

int blink_led_color(enum led_color color, int num_times, int sleep_time_ms) {
    for (int i = 0; i < num_times; i++) {
        int ret = toggle_led_color(color);
        if (ret < 0) {
            return ret;
        }
        k_msleep(sleep_time_ms);
    }
    return 0;
}
```

## src/led_handler.h
```c
/*
  * led_handler.h
  *
  * Created: 28/01/2021, by Lars Fagerbakke for the Nordic Semiconductor Thingy91
  * 
  * No needed flags in prj.conf
*/
#ifndef LED_HANDLER_H_
#define LED_HANDLER_H_

#include <zephyr/kernel.h>
#include <zephyr/drivers/gpio.h>

// Define LED enumeration
enum led_num
{
    LED_0, // Red
    LED_1, // Green
    LED_2  // Blue
};

// Define Color enumeration
enum led_color
{
    LED_COLOR_RED,
    LED_COLOR_GREEN,
    LED_COLOR_BLUE,
    LED_COLOR_YELLOW,
    LED_COLOR_WHITE
};

// Initialize LEDs
int init_leds();

// Toggle LED
int toggle_led(enum led_num);

// Toggle LED with color
int toggle_led_color(enum led_color color);

// Blink LED with color
// num_times must be an even number to end off!
int blink_led_color(enum led_color color, int num_times, int sleep_time_ms);

#endif /* LED_HANDLER_H_ */
```

## src/temp_sensor.c
```c
#include "temp_sensor.h"

static const struct device *const temp_sensor = DEVICE_DT_GET_ANY(bosch_bme680);

int init_temp_sensor()
{
	if (temp_sensor == NULL)
	{
		return 0;
	}

	if (!device_is_ready(temp_sensor))
	{
		return 0;
	}

	return 1;
}

float get_temp()
{
    struct sensor_value temp;

    sensor_sample_fetch(temp_sensor);
    sensor_channel_get(temp_sensor, SENSOR_CHAN_AMBIENT_TEMP, &temp);

    // Cast struct values to float and return
    return (float)temp.val1 + (float)temp.val2 / 1000000;;   
}
```

## src/temp_sensor.h
```c
/*
  * temp_sensor.h
  *
  * Created: 30/01/2021, by Lars Fagerbakke for the Nordic Semiconductor Thingy91
  * 
  * This relies on the CONFIG_SENSOR=y flag in prj.conf
*/
#ifndef TEMP_SENSOR_H_
#define TEMP_SENSOR_H_

#include <zephyr/kernel.h>
#include <zephyr/drivers/sensor.h>

// Initialize temperature sensor
int init_temp_sensor();

// Fetch temperature from sensor
float get_temp();

#endif /* TEMP_SENSOR_H_ */
```
